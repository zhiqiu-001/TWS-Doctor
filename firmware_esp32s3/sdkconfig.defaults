## firmware_esp32s3/sdkconfig.defaults
```kconfig
# ESP32-S3 配置
CONFIG_IDF_TARGET_ESP32S3=y
CONFIG_IDF_TARGET="esp32s3"

# 蓝牙配置 - ESP-IDF 5.x 格式
CONFIG_BT_ENABLED=y
CONFIG_BT_BLE_ENABLED=y

# 蓝牙控制器配置
CONFIG_BT_CONTROLLER_ENABLED=y
CONFIG_BT_CONTROLLER_MODE_BLE_ONLY=y
CONFIG_BT_CONTROLLER_BLE_MAX_CONN=3
CONFIG_BT_CONTROLLER_BLE_ADV_REPORT_FLOW_CONTROL=y
CONFIG_BT_CONTROLLER_BLE_SCAN_DUPLICATE=y
CONFIG_BT_CONTROLLER_BLE_SCAN_DUPLICATE_TYPE=BLE_SCAN_DUPLICATE_FIFO
CONFIG_BT_CONTROLLER_BLE_MAX_SCAN_RES=200

# 蓝牙控制器内存配置（扩展扫描需要更多内存）
CONFIG_BT_CONTROLLER_BLE_MAX_LEN=251
CONFIG_BT_CONTROLLER_BLE_DATA_LEN_MAX=251
CONFIG_BT_CONTROLLER_BLE_DATA_LEN_CUSTOM=y
CONFIG_BT_CONTROLLER_BLE_DATA_LEN_DEFAULT=251

# 蓝牙主机配置（Bluedroid）
CONFIG_BT_BLUEDROID_ENABLED=y
CONFIG_BT_BLE_50_FEATURES_SUPPORTED=y
CONFIG_BT_BLE_50_EXT_ADV_SUPPORTED=y
CONFIG_BT_BLE_50_PER_ADV_SUPPORTED=y
CONFIG_BT_BLE_50_EXT_SCAN_SUPPORTED=y
CONFIG_BT_BLE_50_INITIATOR_FEATURES_SUPPORTED=y
CONFIG_BT_BLE_50_CENTRAL_FEATURES_SUPPORTED=y

# 蓝牙 GAP 配置
CONFIG_BT_GAP_ENABLE=y

# NVS 配置
CONFIG_NVS_ENABLED=y

# FreeRTOS 配置
CONFIG_FREERTOS_UNICORE=n
CONFIG_FREERTOS_HZ=1000

# 日志配置
CONFIG_LOG_DEFAULT_LEVEL_INFO=y
CONFIG_LOG_MAXIMUM_LEVEL_DEBUG=y

# 启用蓝牙调试日志（可选，用于调试）
# CONFIG_BT_DEBUG_LOG=y
```
